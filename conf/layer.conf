## conf/layer.conf
```bitbake
# We have a conf and classes directory, add to BBPATH
BBPATH .= ":${LAYERDIR}"

# We have recipes-* directories, add to BBFILES
BBFILES += "${LAYERDIR}/recipes-*/*/*.bb \
            ${LAYERDIR}/recipes-*/*/*.bbappend "

BBFILE_COLLECTIONS += "miscellaneous"
BBFILE_PATTERN_miscellaneous = "^${LAYERDIR}/"
BBFILE_PRIORITY_miscellaneous = "6"

# This should only be incremented on significant changes that will
# cause compatibility issues with other layers
LAYERVERSION_miscellaneous = "1"
LAYERDEPENDS_miscellaneous = "core"
```
